## Zenbo_TW_13.10.5.129/cht/drivers/input/touchscreen/gt9110/Kconfig
```kconfig
config TOUCHSCREEN_GT9110
        tristate "Goodix GT9110 touchscreen"
        depends on I2C
        default y
        help
                Say Y here if you have a Goodix GT9110 touchscreen
                If unsure, say N.
```

## Zenbo_TW_13.10.5.129/cht/drivers/sensor/Kconfig
```kconfig
config GPIO_SENSOR
        tristate "Functions to control sensor gpio state"
        help
           Say Y here if you need to control sensor gpio state.
```
